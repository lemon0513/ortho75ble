## config/boards/shields/ortho75ble/Kconfig.defconfig
```kconfig
# Copyright (c) 2020 The ZMK Contributors
# SPDX-License-Identifier: MIT

if SHIELD_ORTHO75BLE

config ZMK_KEYBOARD_NAME
    default "Ortho75BLE"

endif
```

## config/boards/shields/ortho75ble/Kconfig.shield
```kconfig
# Copyright (c) 2020 The ZMK Contributors
# SPDX-License-Identifier: MIT

config SHIELD_ORTHO75BLE
    def_bool $(shields_list_contains,ortho75ble)
```
